## config/west.yml
```yaml
manifest:
  remotes:
    - name: zmkfirmware
      url-base: https://github.com/zmkfirmware
    - name: sekigon-gonnoc
      url-base: https://github.com/sekigon-gonnoc
    - name: ld50themetaler
      url-base: https://github.com/ld50themetaler
    - name: prospector
      url-base: https://github.com/t-ogura
  projects:
    - name: zmk
      remote: zmkfirmware
      revision: v0.2
      import: app/west.yml
    - name: zmk-component-ble-micro-pro
      remote: sekigon-gonnoc
      revision: v0.2
    - name: zmk-driver-kscan-74hc164-matrix
      remote: sekigon-gonnoc
    - name: zmk-feature-status-led
      remote: sekigon-gonnoc
      revision: main
    - name: zmk-feature-cdc-acm-bootloader-trigger
      remote: sekigon-gonnoc
      revision: v0.2
    - name: zmk-feature-non-lipo-battery-management
      remote: sekigon-gonnoc
      revision: main
    - name: zmk-pmw3610-driver
      remote: ld50themetaler
      revision: torabo-tsuki
    - name: prospector-zmk-module
      remote: prospector
      revision: v2.2b
      path: modules/prospector-zmk-module
  self:
    path: config
```
